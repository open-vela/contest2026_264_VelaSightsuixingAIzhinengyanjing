## app/agent_camera/Kconfig
```kconfig
#
# For a description of the syntax of this configuration file,
# see the file kconfig-language.txt in the NuttX tools repository.
#

config LVX_USE_DEMO_CONTEST2026_264_AGENT_CAMERA
	bool "ai_agent camera-path bench"
	default n
	depends on VIDEO
	---help---
		Runs the V4L2 half of packages/ai_agent's camera_capture tool
		(src/tools/tool_camera.c) on this board: same ioctl order, same
		V4L2_MEMORY_MMAP buffers, same JPEG-then-ENTROPY fallback, same
		5s poll timeout -- but it validates the JPEG markers and can
		write the frame to a file instead of posting it to a Vision LLM,
		which the AP core cannot reach while it has no network device.

		Use it to tell the two failure modes apart: a JPEG capture path
		that does not deliver frames, versus a geometry the tool asks
		for that this driver does not program (it wants 320x180 or
		1280x720; the driver has 480x480 / 640x480 / 864x480).
```

## app/jpeg_test/Kconfig
```kconfig
#
# For a description of the syntax of this configuration file,
# see the file kconfig-language.txt in the NuttX tools repository.
#

config LVX_USE_DEMO_CONTEST2026_264_JPEG_TEST
	bool "BK7258 V4L2 M2M JPEG encoder test"
	default n
	depends on BK7258_JPEG_ENC
	---help---
		Enable the jpeg_test NSH command: builds a synthetic YUV frame in
		memory, pushes it through the V4L2 M2M JPEG encoder, and reports the
		encoded size, elapsed time and compression ratio.

		Needing no camera is the point -- the codec can be verified while the
		capture path is still being developed.

		The frame is colour bars over a luma ramp rather than noise, so
		'jpeg_test dump' produces a base64 JPEG that can be rebuilt on a host
		and checked by eye: a swapped chroma plane or a wrong stride is
		obvious in the picture but invisible in the compression ratio.
```

## board/beken/boards/bk7258/bk7258-ap/Kconfig
```kconfig
if ARCH_BOARD_CUSTOM

config ARCH_BOARD_BK7258_AP
	bool "BK7258 AP board"
	default y
	select ARCH_HAVE_BUTTONS
	select ARCH_HAVE_LEDS

config BK7258_MB_UART0_CONSOLE
	bool "Use CP UART0 through Mailbox V2 for the AP console"
	default y
	depends on SERIAL
	select BK7258_MBOX_V2
	select OTHER_UART_SERIALDRIVER
	select SERIAL_IFLOWCONTROL
	select SERIAL_IFLOWCONTROL_WATERMARKS

config BK7258_POWER_KEY_MOTOR
	bool "Vibrate while the power key is pressed"
	default n
	depends on ARCH_BUTTONS && PWM
	help
		Poll the active-low GPIO12 power key using the Beken 5 ms/6 sample
		debounce timing. Drive the vibration motor at 1 kHz and 70 percent
		duty while the key is held, and stop it when the key is released.

endif
```

## board/beken/chips/bk7258/Kconfig
```kconfig
if ARCH_CHIP_CUSTOM

comment "Beken BK7258 Configuration Options"

config ARCH_CHIP_BK7258
	bool "BK7258 AP"
	default y
	select ARCH_CORTEXM33
	select ARCH_HAVE_CUSTOM_VECTORS
	select ARCH_HAVE_FPU
	select ARCH_HAVE_MPU
	select ARM_HAVE_MPU_UNIFIED
	select ARCH_HAVE_TRUSTZONE

config BK7258_CPU_FREQ_HZ
	int "CPU1 fixed frequency"
	default 120000000
	help
		CPU1 frequency used by the SysTick lower-half during initial
		bring-up. Runtime DVFS is intentionally unsupported.

config BK7258_MBOX_V2
	bool
	default y

config BK7258_MB_UART0_TXBUFSIZE
	int "Mailbox UART0 transport TX ring size"
	default 8192
	range 1024 32767
	depends on BK7258_MBOX_V2
	help
		AP-owned byte ring. The fixed wire exchange chunk remains 128 bytes.

config BK7258_MB_UART0_RXBUFSIZE
	int "Mailbox UART0 transport RX capacity"
	default 256
	range 256 4096
	depends on BK7258_MBOX_V2

config BK7258_MB_UART0_SERIAL_RXBUFSIZE
	int "Mailbox UART0 NuttX serial RX buffer size"
	default 256
	depends on BK7258_MBOX_V2

config BK7258_MB_UART0_SERIAL_TXBUFSIZE
	int "Mailbox UART0 NuttX serial TX buffer size"
	default 512
	depends on BK7258_MBOX_V2

config BK7258_PSRAM
	bool "BK7258 CP-managed PSRAM"
	default n
	help
		Map the CP-initialized 16 MB PSRAM window for OpenVela. The AP does
		not initialize the PSRAM PHY and this option does not add PSRAM to
		the NuttX system heap.

config BK7258_PSRAM_SIZE
	hex "BK7258 PSRAM capacity"
	default 0x01000000
	depends on BK7258_PSRAM
	help
		Physical PSRAM capacity required by the validated app_ab layout.

config BK7258_PSRAM_REQUIRED
	bool "Require PSRAM before reporting AP ready"
	default n
	depends on BK7258_PSRAM
	help
		Fail board bring-up and suppress the AP ready notification when the
		CP power vote, AP-owned memory probe, or allocators cannot be set up.

config BK7258_PSRAM_KEEP_POWERED
	bool "Keep PSRAM powered while AP runs"
	default y
	depends on BK7258_PSRAM
	help
		Retain the CPU1 PSRAM power vote for the AP lifetime. Dynamic PSRAM
		power-down is not safe until all media and DMA leases are integrated.


config BK7258_AUDIO
	bool "BK7258 internal analog audio (AUD)"
	default n
	select AUDIO
	help
		Drive the chip's internal 16-bit mono DAC and analog MIC ADC. On this
		board the differential AUDLP/AUDLN pair feeds an HT6872 class-D
		amplifier whose CTRL (mute) pin is GPIO50, and there is no I2S codec.
		Asks CP1 for the AUDP power domain and the AUD module clock over the
		PWC mailbox channel.

config BK7258_AUDIO_CAPTURE
	bool "BK7258 audio capture (MIC1 + AEC reference)"
	default n
	depends on BK7258_AUDIO
	help
		Enable the ADC path. MIC1 (MICP1/MICN1) is the electret microphone.
		When BK7258_AUDIO_AEC_REFERENCE is also set, MIC2 (MICP2/MICN2) is
		enabled as well and carries the post-amplifier speaker feedback, so
		captured frames are L/R interleaved with L = voice and R = echo
		reference.

config BK7258_AUDIO_AEC_REFERENCE
	bool "Capture the MIC2 hardware echo reference"
	default n
	depends on BK7258_AUDIO_CAPTURE
	help
		The schematic taps HT6872 OUT+/OUT- through R84/R83 (39K) and
		C61/C60 (1uF) into MIC2P/MIC2N so that AEC can have a hardware echo
		reference, and ana_reg27 does have a full micen field for MIC2.

		This defaults to n because the reference cannot actually be read on
		BK7258: measured on hardware, the ADC delivers a single channel and
		the upper half of every AUD_ADC_FIFO_PORT word stays zero. With a
		tone audibly playing and MIC1 picking it up acoustically (RMS rising
		from 25.7 to 36.4), MIC2 still returned exactly zero across 15872
		samples. That matches the vendor HAL, where sys_hal_aud_mic2_en()
		and sys_hal_aud_dacr_en() are both explicit "//not support" stubs
		for this SoC: the register fields exist, the datapath does not.

		Enabling this only costs half of every capture buffer to zeros. Use
		a software AEC reference instead -- feed aec_proc() the same PCM
		that was queued to the DAC, which is cleaner anyway (no analog
		noise, no divider tolerance) and needs only a fixed delay
		compensation for the DAC and amplifier.

config BK7258_AUDIO_SAMPLERATE
	int "Default audio sample rate"
	default 16000
	depends on BK7258_AUDIO
	help
		Used when the application does not configure a rate explicitly. Only
		8000, 16000 and 32000 are currently reachable: the driver runs the
		audio block from the 26 MHz crystal, and the 44100/48000 families
		additionally require the APLL calibration sequence, which has not
		been ported yet.

config BK7258_AUDIO_PA_MUTE_GPIO
	int "External amplifier mute GPIO"
	default 50
	depends on BK7258_AUDIO
	help
		BK7258 GPIO driving net MUTE, which reaches the HT6872 CTRL pin
		through R70 (1K). R71 (10K) pulls it low, so the amplifier is muted
		until software drives this pin high. Per the board schematic
		(AIDK_AI玩具开发板_原理图.pdf) MUTE is P50.

config BK7258_AUDIO_PA_ON_DELAY_MS
	int "Delay between DAC enable and amplifier un-mute"
	default 20
	depends on BK7258_AUDIO
	help
		Mirrors onboard_speaker_stream's pa_on_delay: the DAC is started,
		this delay elapses, then the amplifier is un-muted. Keeps the
		amplifier off while the analog output settles so there is no pop.

config BK7258_AUDIO_PA_OFF_DELAY_MS
	int "Delay between DAC mute and amplifier shutdown"
	default 10
	depends on BK7258_AUDIO
	help
		Mirrors onboard_speaker_stream's pa_off_delay. Note the vendor's
		header comment and its code disagree on where this delay sits; the
		code order (mute, delay, amplifier off, DAC teardown) is the one that
		actually suppresses the pop and is what this driver implements.

endif
```
